## buildroot_setup/buildroot_overlay/Config.in
```kconfig
source "$BR2_EXTERNAL_rv32ima_overlay_PATH/package/fbdoom/Config.in"
source "$BR2_EXTERNAL_rv32ima_overlay_PATH/package/freedoom1-wad/Config.in"
```

## buildroot_setup/buildroot_overlay/configs/rv32ima_defconfig
```kconfig
BR2_riscv=y
BR2_riscv_custom=y
BR2_RISCV_ISA_RVM=y
BR2_RISCV_ISA_RVA=y
BR2_RISCV_32=y
# BR2_RISCV_USE_MMU is not set
BR2_PACKAGE_HOST_LINUX_HEADERS_CUSTOM_6_6=y
BR2_DOWNLOAD_FORCE_CHECK_HASHES=y
# BR2_TARGET_ENABLE_ROOT_LOGIN is not set
# BR2_TARGET_GENERIC_GETTY is not set
# BR2_TARGET_GENERIC_REMOUNT_ROOTFS_RW is not set
BR2_ROOTFS_OVERLAY="$(BR2_EXTERNAL)/board/rv32ima/overlay"
BR2_LINUX_KERNEL=y
BR2_LINUX_KERNEL_CUSTOM_VERSION=y
BR2_LINUX_KERNEL_CUSTOM_VERSION_VALUE="6.6.83"
BR2_LINUX_KERNEL_USE_CUSTOM_CONFIG=y
BR2_LINUX_KERNEL_CUSTOM_CONFIG_FILE="$(BR2_EXTERNAL)/board/rv32ima/linux-nommu.config"
BR2_LINUX_KERNEL_PATCH="$(BR2_EXTERNAL)/board/rv32ima/patches/linux"
BR2_TARGET_ROOTFS_CPIO=y
BR2_TARGET_ROOTFS_INITRAMFS=y
# BR2_TARGET_ROOTFS_EXT2 is not set
# BR2_TARGET_ROOTFS_TAR is not set
BR2_PACKAGE_HOST_DTC=y
BR2_PACKAGE_FBDOOM=y
BR2_PACKAGE_FREEDOOM1_WAD=y
```

## buildroot_setup/buildroot_overlay/package/fbdoom/Config.in
```kconfig
config BR2_PACKAGE_FBDOOM
	bool "fbdoom"
	help
	  Framebuffer-oriented Doom port built from maximevince/fbDOOM.

	  The binary is installed as /fbdoom in the target rootfs.
```

## buildroot_setup/buildroot_overlay/package/freedoom1-wad/Config.in
```kconfig
config BR2_PACKAGE_FREEDOOM1_WAD
	bool "freedoom1.wad"
	help
	  Install Freedoom Phase 1 IWAD as /freedoom1.wad in the target rootfs.
```
